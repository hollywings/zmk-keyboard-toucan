## boards/shields/toucan_dongle_display/Kconfig.shield
```kconfig
config SHIELD_TOUCAN_DONGLE_DISPLAY
    def_bool $(shields_list_contains,toucan_dongle_display)
```

## config/west.yml
```yaml
manifest:
  defaults:
    revision: main
  remotes:
    - name: zmkfirmware
      url-base: https://github.com/zmkfirmware
    - name: caksoylar
      url-base: https://github.com/caksoylar
    - name: hitsmaxft
      url-base: https://github.com/hitsmaxft
  projects:
    - name: zmk
      remote: zmkfirmware
      revision: main
      import: app/west.yml
    - name: zmk-rgbled-widget
      remote: caksoylar
      revision: main
    - name: zmk-dongle-screen-engine
      remote: hitsmaxft
      revision: v1.4.1
      path: modules/zmk-dongle-screen-engine
    - name: zdse-themes
      remote: hitsmaxft
      revision: main
      path: modules/zdse-themes
  self:
    path: config
```
